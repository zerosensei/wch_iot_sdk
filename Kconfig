## kernel/Kconfig
```kconfig
# Copyright (c) 2022 Nanjing Qinheng Microelectronics Co., Ltd.
# SPDX-License-Identifier: Apache-2.0

menu "General Kernel Options"

config SYS_CLOCK_TICKS_PER_SEC
	int "System tick frequency (in ticks/second)"
	default 10000 if TICKLESS_KERNEL
	default 100
	help
	  This option specifies the nominal frequency of the system clock in Hz.

	  For asynchronous timekeeping, the kernel defines a "ticks" concept. A
	  "tick" is the internal count in which the kernel does all its internal
	  uptime and timeout bookkeeping. Interrupts are expected to be delivered
	  on tick boundaries to the extent practical, and no fractional ticks
	  are tracked.

	  The choice of tick rate is configurable by this option. Also the number
	  of cycles per tick should be chosen so that 1 millisecond is exactly
	  represented by an integral number of ticks. Defaults on most hardware
	  platforms (ones that support setting arbitrary interrupt timeouts) are
	  expected to be in the range of 10 kHz, with software emulation
	  platforms and legacy drivers using a more traditional 100 Hz value.

	  Note that when available and enabled, in "tickless" mode
	  this config variable specifies the minimum available timing
	  granularity, not necessarily the number or frequency of
	  interrupts delivered to the kernel.

	  A value of 0 completely disables timer support in the kernel.

config SYS_CLOCK_HW_CYCLES_PER_SEC
	int "System clock's h/w timer frequency"
	help
	  This option specifies the frequency of the hardware timer used for the
	  system clock (in Hz). This option is set by the SOC's or board's Kconfig file
	  and the user should generally avoid modifying it via the menu configuration.

config SYS_CLOCK_EXISTS
	bool "System clock exists and is enabled"
	default y
	help
	  This option specifies that the kernel has timer support.

	  Some device configurations can eliminate significant code if
	  this is disabled.  Obviously timeout-related APIs will not
	  work when disabled.

config TIMEOUT_64BIT
	bool "Store kernel timeouts in 64 bit precision"
	default y
	help
	  When this option is true, the k_ticks_t values passed to
	  kernel APIs will be a 64 bit quantity, allowing the use of
	  larger values (and higher precision tick rates) without fear
	  of overflowing the 32 bit word.  This feature also gates the
	  availability of absolute timeout values (which require the
	  extra precision).

config SYS_CLOCK_MAX_TIMEOUT_DAYS
	int "Max timeout (in days) used in conversions"
	default 365
	help
	  Value is used in the time conversion static inline function to determine
	  at compile time which algorithm to use. One algorithm is faster, takes
	  less code but may overflow if multiplication of source and target
	  frequency exceeds 64 bits. Second algorithm prevents that. Faster
	  algorithm is selected for conversion if maximum timeout represented in
	  source frequency domain multiplied by target frequency fits in 64 bits.

config TICKLESS_KERNEL
	bool "Tickless kernel"
	default y if TICKLESS_CAPABLE
	depends on TICKLESS_CAPABLE
	help
	  This option enables a fully event driven kernel. Periodic system
	  clock interrupt generation would be stopped at all times.

endmenu
```

## soc/Kconfig
```kconfig
# Copyright (c) 2022 Nanjing Qinheng Microelectronics Co., Ltd.
# SPDX-License-Identifier: Apache-2.0

source "soc/$(ARCH)/$(SOC_SERIES)/Kconfig.series"

menu "Hardware Configuration"
    source "soc/$(ARCH)/$(SOC_SERIES)/Kconfig.soc"

    module = SOC
    module-str = SOC
    source "subsys/logging/Kconfig.template.log_config"
endmenu
```

## soc/ch57x/Kconfig.soc
```kconfig
# Copyright (c) 2022 Nanjing Qinheng Microelectronics Co., Ltd.
# SPDX-License-Identifier: Apache-2.0

choice
    prompt "SoC"

    config SOC_CH573X
        bool "CH573X"
        depends on SOC_SERIES_CH57X

    config SOC_CH573F
        bool "CH573F"
        depends on SOC_SERIES_CH57X

    config SOC_CH571F
        bool "CH571F"
        depends on SOC_SERIES_CH57X

    config SOC_CH571D
        bool "CH571D"
        depends on SOC_SERIES_CH57X

    config SOC_CH571K
        bool "CH571K"
        depends on SOC_SERIES_CH57X

endchoice

config SOC_DCDC_CH57X
    bool "SoC DC/DC CH57X"
    depends on SOC_CH573X || SOC_CH573F || SOC_CH571F
    help
      Enable CH57X series System on Chip DC/DC converter.

choice
    prompt "SoC RTC source select"

    config SOC_LSE_32768
        bool "LSE 32768Hz"
    config SOC_LSI_32000
        bool "LSI 32000Hz"
    config SOC_LSI_32768
        bool "LSI 32768Hz"

endchoice

config SOC_RTC_FREQ
    int
    default 32768 if SOC_LSE_32768 || SOC_LSI_32768
    default 32000 if SOC_LSI_32000
    help
      SoC RTC frequency (in Hz).

config SOC_RTC_MAX_TICK
    hex 
    default 0xA8C00000


config SOC_SYSTEM_OPERATE_FREQ
    int "System Operating Frequency"
    default 60000000
    help
      System operating frequency. 

config SYS_CLOCK_HW_CYCLES_PER_SEC
    default 32768

config SYS_CLOCK_TICKS_PER_SEC
    default 32768

config ADC_CHANNEL_MAP
    default 0xF33F if SOC_CH573X
    default 0xF03F if SOC_CH573F
    default 0xC03F if SOC_CH571F || SOC_CH571D
    default 0xC03C if SOC_CH571K

config BT_SNV_ADDR
    default 0x3EC00
```

## soc/ch57x/ch57x_defconfig
```kconfig
CONFIG_SOC_SERIES_CH57X=y
CONFIG_SOC_CH573F=y
CONFIG_SYS_CLOCK_HW_CYCLES_PER_SEC=32768
CONFIG_SYS_CLOCK_TICKS_PER_SEC=32768
CONFIG_BT_SNV_ADDR=0x3EC00
CONFIG_GPIO=y
```

## soc/riscv/ch57x/Kconfig.series
```kconfig
# Copyright (c) 2022 Nanjing Qinheng Microelectronics Co., Ltd.
# SPDX-License-Identifier: Apache-2.0

config SOC_SERIES_CH57X
    bool
    select RISCV
    select RISCV_ISA_EXT_M
    select RISCV_ISA_EXT_A
```

## soc/riscv/ch58x/Kconfig.soc
```kconfig
# Copyright (c) 2022 Nanjing Qinheng Microelectronics Co., Ltd.
# SPDX-License-Identifier: Apache-2.0

config SOC_SERIES_CH58X
    default y

choice
    prompt "CH57x MCU Selection"
    default SOC_CH583M

    config SOC_CH583M
        bool "CH583M"

    config SOC_CH582M
        bool "CH582M"

    config SOC_CH582F
        bool "CH582F"

    config SOC_CH581F
        bool "CH581F"

endchoice

config SOC_DCDC_CH58X
    bool "SoC DC/DC CH58X"
    help
      Enable CH58X series System on Chip DC/DC converter.

choice
    prompt "SoC RTC source select"

    config SOC_LSE_32768
        bool "LSE 32768Hz"
    config SOC_LSI_32000
        bool "LSI 32000Hz"
    config SOC_LSI_32768
        bool "LSI 32768Hz"

endchoice

config SOC_RTC_FREQ
    int
    default 32768 if SOC_LSE_32768 || SOC_LSI_32768
    default 32000 if SOC_LSI_32000
    help
      SoC RTC frequency (in Hz).

config SOC_RTC_MAX_TICK
    hex 
    default 0xA8C00000


config SOC_SYSTEM_OPERATE_FREQ
    int "System Operating Frequency"
    default 60000000
    help
      System operating frequency. 

config SYS_CLOCK_HW_CYCLES_PER_SEC
    default 32768

config SYS_CLOCK_TICKS_PER_SEC
    default 32768

config ADC_CHANNEL_MAP
    default 0xFFFF if SOC_CH582M || SOC_CH583M
    default 0xF03F if SOC_CH582F
    default 0xC03F if SOC_CH581F


config BT_SNV_ADDR
    default 0x7E00
```

## soc/riscv/ch58x/ch58x_defconfig
```kconfig
# Copyright (c) 2022 Nanjing Qinheng Microelectronics Co., Ltd.
# SPDX-License-Identifier: Apache-2.0

CONFIG_GPIO=y
CONFIG_UART=y
CONFIG_PINCTRL=y
```

## subsys/Kconfig
```kconfig
# Copyright (c) 2022 Nanjing Qinheng Microelectronics Co., Ltd.
# SPDX-License-Identifier: Apache-2.0

menu "Sub Systems"

source "subsys/bluetooth/Kconfig"

source "subsys/logging/Kconfig"

source "subsys/pm/Kconfig"

source "subsys/usb/Kconfig"

source "subsys/buf/Kconfig"

endmenu
```

## subsys/bluetooth/Kconfig
```kconfig
# Copyright (c) 2022 Nanjing Qinheng Microelectronics Co., Ltd.
# SPDX-License-Identifier: Apache-2.0

menuconfig BT
    bool "Bluetooth"

    help
      Enable bluetooth support.

if BT
config BT_CUSTOM_ADDRESS
    bool "Use custom address"
    default n
    help
      Use custom address, otherwise use chip MAC address.
      
config BT_STACK_SIZE
    int "Bluetooth Stack size"
    default 6144
    help
      Configure the Bluetooth stack size.
      Should not be less than 6K.

config BT_SNV
    bool "Bluetooth SNV"
    default y
    help
      Enable Bluetooth SNV function.
      
config BT_SNV_ADDR
    hex "Bluetooth SNV start address"
    # TODO: depends on flash
    default 0 
    depends on BT_SNV
    help
      Configure the Bluetooth snv start address.

config BT_TEM_SAMPLE
    bool "Bluetooth TEM sample"
    # default y
    help
      Enable the function of calibrating according 
      to temperature changes, and a single 
      calibration takes less than 10ms.

config BT_CALIBRATION
    bool "Bluetooth calibration"
    default y
    help
      Enable the function of timing calibration, 
      and a single calibration takes less than 10ms.

config BT_CALIBRATION_PERIOD
    int "Bluetooth calibration period"
    default 120000
    help
      Configure bluetooth calibration period, unit 625us. 

config BT_L2CAP_TX_SIZE
    int "Maximun size for L2CAP Tx buffers"
    range 27 251
    default 27
    help
      Maximum size for L2CAP TX buffers.

config BT_L2CAP_BUF_NUM
    int "Number of L2CAP buffers"
    default 5
    help
      Number of buffers available for L2CAP packets.

config BT_L2CAP_TX_EVENT_NUM
    int "Maximum number of TX data in a connection event"
    default 1
    help
      Maximum number of TX data in a connection event. Defaut 1.

config BT_L2CAP_RX_EVENT_NUM
    int "Maximum number of RX data in a connection event"
    default BT_L2CAP_TX_EVENT_NUM
    help
      Maximum number of RX data in a connection event.
      Default equal to BufNumber.

choice BT_CTLR_TX_PWR
	prompt "Tx Power"
	default BT_CTLR_TX_PWR_0
	help
	  Select the supported BLE Radio transmit power level in dBm.

config BT_CTLR_TX_PWR_PLUS_7
  depends on SOC_CH32V208 || SOC_CH32F208
	bool "+7 dBm"

config BT_CTLR_TX_PWR_PLUS_6
  depends on SOC_CH32V208 || SOC_CH32F208
	bool "+6 dBm"

config BT_CTLR_TX_PWR_PLUS_5
	bool "+5 dBm"

config BT_CTLR_TX_PWR_PLUS_4
	bool "+4 dBm"

config BT_CTLR_TX_PWR_PLUS_3
	bool "+3 dBm"

config BT_CTLR_TX_PWR_PLUS_2
	bool "+2 dBm"

config BT_CTLR_TX_PWR_PLUS_1
	bool "+1 dBm"

config BT_CTLR_TX_PWR_0
	bool "0 dBm"

config BT_CTLR_TX_PWR_MINUS_4
	bool "-4 dBm"

config BT_CTLR_TX_PWR_MINUS_8
	bool "-8 dBm"

config BT_CTLR_TX_PWR_MINUS_12
	bool "-12 dBm"

config BT_CTLR_TX_PWR_MINUS_16
	bool "-16 dBm"

config BT_CTLR_TX_PWR_MINUS_20
	bool "-20 dBm"

endchoice

config BT_PERIPHERAL_MAX_CONNECTION
    int "Peripheral maximum connection number"
    default 1
    help
      The number of slave roles that can be 
      played at the same time.

config BT_CENTRAL_MAX_CONNECTION
    int "Central maximum connection number"
    default 1
    help
      The number of master roles that can be 
      played at the same time.  


endif
```

## subsys/bluetooth/Kconfig.adv
```kconfig
# Copyright (c) 2022 Nanjing Qinheng Microelectronics Co., Ltd.
# SPDX-License-Identifier: Apache-2.0

config BT_EXT_ADV
    bool "Extended Advertising and Scanning Support"
    help
      Select to enable extended advertising support.
```

## subsys/buf/Kconfig
```kconfig
# Copyright (c) 2022 Nanjing Qinheng Microelectronics Co., Ltd.
# SPDX-License-Identifier: Apache-2.0

menu "Buffer"

config BUF_LOG
    bool "Buffer logging"
    select LOG
    help
      Enable logs and checks for buffers.

module = BUF
module-str = BUF
source "subsys/logging/Kconfig.template.log_config"

endmenu
```
