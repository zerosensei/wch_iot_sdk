## Kconfig
```kconfig
# Copyright (c) 2022 Nanjing Qinheng Microelectronics Co., Ltd.
# SPDX-License-Identifier: Apache-2.0

mainmenu "WCH iot SDK Configuration"

source "kernel/Kconfig"

source "soc/Kconfig"

source "arch/Kconfig"

source "drivers/Kconfig"

source "subsys/Kconfig"

menu "Build an Compiler Features"
menu "Compiler Options"

config CODING_GUIDELINE_CHECK
	bool "Enforce coding guideline rules"
	help
	  Use available compiler flags to check coding guideline rules during
	  the build.

choice COMPILER_OPTIMIZATIONS
	prompt "Optimization level"
	default SIZE_OPTIMIZATIONS
	help
	  Note that these flags shall only control the compiler
	  optimization level, and that no extra debug code shall be
	  conditionally compiled based on them.

config SIZE_OPTIMIZATIONS
	bool "Optimize for size"
	help
	  Compiler optimizations will be set to -Os independently of other
	  options.

config SPEED_OPTIMIZATIONS
	bool "Optimize for speed"
	help
	  Compiler optimizations will be set to -O2 independently of other
	  options.

config DEBUG_OPTIMIZATIONS
	bool "Optimize debugging experience"
	help
	  Compiler optimizations will be set to -Og independently of other
	  options.

config NO_OPTIMIZATIONS
	bool "Optimize nothing"
	help
	  Compiler optimizations will be set to -O0 independently of other
	  options.

endchoice

config COMPILER_COLOR_DIAGNOSTICS
	bool "Colored diagnostics"
	default y
	help
	  Compiler diagnostic messages are colorized.

config COMPILER_OPT
	string "Custom compiler options"
	help
	  This option is a free-form string that is passed to the compiler
	  when building all parts of a project (i.e. kernel).
	  The compiler options specified by this string supplement the
	  predefined set of compiler supplied by the build system,
	  and can be used to change compiler optimization, warning and error
	  messages, and so on.

endmenu


menu "Build Options"

config KERNEL_BIN_NAME
	string "The kernel binary name"
	default "wch"
	help
	  This option sets the name of the generated kernel binary.

config OUTPUT_STAT
	bool "Create a statistics file"
	default y
	help
	  Create a stat file using readelf -e <elf>

config OUTPUT_SYMBOLS
	bool "Create a symbol file"
	help
	  Create a symbol file using nm <elf>

config OUTPUT_DISASSEMBLY
	bool "Create a disassembly file"
	default y
	help
	  Create an .lst file with the assembly listing of the firmware.

config OUTPUT_DISASSEMBLE_ALL
	bool "Disassemble all sections with source. Fill zeros."
	default n
	depends on OUTPUT_DISASSEMBLY
	help
	  The .lst file will contain complete disassembly of the firmware
	  not just those expected to contain instructions including zeros

config OUTPUT_PRINT_MEMORY_USAGE
	bool "Print memory usage to stdout"
	default y
	help
	  If the toolchain supports it, this option will pass
	  --print-memory-region to the linker when it is doing it's first
	  linker pass. Note that the memory regions are symbolic concepts
	  defined by the linker scripts and do not necessarily map
	  directly to the real physical address space. Take also note that
	  some platforms do two passes of the linker so the results do not
	  match exactly to the final elf file. See also rom_report,
	  ram_report and
	  https://sourceware.org/binutils/docs/ld/MEMORY.html

config BUILD_NO_GAP_FILL
	bool "Don't fill gaps in generated hex/bin/s19 files."

config BUILD_OUTPUT_HEX
	bool "Build a binary in HEX format"
	help
	  Build an Intel HEX binary in the build directory.
	  The name of this file can be customized with CONFIG_KERNEL_BIN_NAME.

config BUILD_OUTPUT_BIN
	bool "Build a binary in BIN format"
	default y
	help
	  Build a "raw" binary in the build directory.
	  The name of this file can be customized with CONFIG_KERNEL_BIN_NAME.

config BUILD_OUTPUT_EXE
	bool "Build a binary in ELF format with .exe extension"
	help
	  Build an ELF binary that can run in the host system in the build directory.
	  The name of this file can be customized with CONFIG_KERNEL_BIN_NAME.

config BUILD_OUTPUT_S19
	bool "Build a binary in S19 format"
	help
	  Build an S19 binary in the build directory.
	  The name of this file can be customized with CONFIG_KERNEL_BIN_NAME.

config BUILD_OUTPUT_STRIPPED
	bool "Build a stripped binary"
	help
	  Build a stripped binary in the build directory.
	  The name of this file can be customized with CONFIG_KERNEL_BIN_NAME.


endmenu

endmenu
```

## arch/Kconfig
```kconfig
# Copyright (c) 2022 Nanjing Qinheng Microelectronics Co., Ltd.
# SPDX-License-Identifier: Apache-2.0

menu "General Architecture Options"

config RISCV
	bool
	help
	  RISCV architecture

config ARM
    bool
    help
      ARM architecture

config ARCH
    string
    help
      Architecture string

source "arch/$(ARCH)/Kconfig"

module = ARCH
module-str = arch
source "subsys/logging/Kconfig.template.log_config"

endmenu
```

## arch/riscv/Kconfig
```kconfig
# Copyright (c) 2022 Nanjing Qinheng Microelectronics Co., Ltd.
# SPDX-License-Identifier: Apache-2.0

menu "RISC-V Options"
	depends on RISCV

config ARCH
    string
	default "riscv64" if 64BIT
	default "riscv32"


config HAS_RISCV_PMP
	bool
	help
	  Select to enable RISCV_PMP

config RISCV_PMP
	bool "RISC-V PMP Support"
	depends on HAS_RISCV_PMP
	help
	  MCU implements Physical Memory Protection.

if RISCV_PMP

config PMP_SLOTS
	int "Number of PMP slots"
	default 8
	help
	  This is the number of PMP entries implemented by the hardware.
	  Typical values are 8 or 16.

endif

endmenu
```

## arch/riscv/Kconfig.core
```kconfig
# Copyright (c) 2022 Nanjing Qinheng Microelectronics Co., Ltd.
# SPDX-License-Identifier: Apache-2.0

config RISCV_CORE_QINGKE_V3A
    bool 
    select RISCV_ISA_RV32I
	select RISCV_ISA_EXT_M
	select RISCV_ISA_EXT_A
	select RISCV_ISA_EXT_C
    help
      WCH QINGKE V3A Standard Core

config RISCV_CORE_QINGKE_V4A
    bool
	select RISCV_PMP
    select RISCV_ISA_RV32I
	select RISCV_ISA_EXT_M
	select RISCV_ISA_EXT_A
	select RISCV_ISA_EXT_C
    help
      WCH QINGKE V4A Standard Core

# TODO: 在调试上可能存在一些差别， 且中断嵌套，硬件堆栈存在等存在差别，需再细分
config RISCV_CORE_QINGKE_V4B
    bool
	select RISCV_PMP
    select RISCV_ISA_RV32I
	select RISCV_ISA_EXT_M
	select RISCV_ISA_EXT_A
	select RISCV_ISA_EXT_C
    select RISCV_WCH_EXT_XW
    help
      WCH QINGKE V4B Standard Core

config RISCV_CORE_QINGKE_V4C
    bool
	select RISCV_PMP
    select RISCV_ISA_RV32I
	select RISCV_ISA_EXT_M
	select RISCV_ISA_EXT_A
	select RISCV_ISA_EXT_C
    select RISCV_WCH_EXT_XW
    help
      WCH QINGKE V4C Standard Core

config RISCV_CORE_QINGKE_V4F
    bool
	select RISCV_PMP
    select RISCV_ISA_RV32I
	select RISCV_ISA_EXT_M
	select RISCV_ISA_EXT_A
	select RISCV_ISA_EXT_C
    select RISCV_ISA_EXT_F
    select RISCV_WCH_EXT_XW
    help
      WCH QINGKE V4F Standard Core
```

## drivers/Kconfig
```kconfig
# Copyright (c) 2022 Nanjing Qinheng Microelectronics Co., Ltd.
# SPDX-License-Identifier: Apache-2.0

menu "Device Drivers"

source "drivers/uart/Kconfig"

source "drivers/timer/Kconfig"

source "drivers/pinctrl/Kconfig"

source "drivers/gpio/Kconfig"

source "drivers/debug/Kconfig"

source "drivers/adc/Kconfig"

endmenu
```

## drivers/adc/Kconfig
```kconfig
# Copyright (c) 2022 Nanjing Qinheng Microelectronics Co., Ltd.
# SPDX-License-Identifier: Apache-2.0

menuconfig ADC
    bool "ADC drivers"
    help
      Enable ADC drivers.

if ADC

config ADC_CHANNEL_MAP
    hex "ADC channel map"
    help
      Bit-mask indicating the channels to be supported by the driver.
      

module = ADC
module-str = ADC
source "subsys/logging/Kconfig.template.log_config"

endif
```

## drivers/debug/Kconfig
```kconfig
# Copyright (c) 2022 Nanjing Qinheng Microelectronics Co., Ltd.
# SPDX-License-Identifier: Apache-2.0

menuconfig DEBUG
    bool "Debugging Options"
	default y
    help
      Enable debugging options.
    
if DEBUG

config PRINTK
    bool "Enable printk() fuction"
    default y
    help
      This option enables the printk() to be sent out.

config ASSERT
	bool "__ASSERT() macro"
	depends on PRINTK
	help
      This enables the __ASSERT() macro in the code. If an assertion fails, 
      the policy for what to do is controlled by the implementation of the 
      assert_post_action() function.

choice DEBUG_PORT
	prompt "Select debug port"
	default DEBUG_PORT_UART_1

	config DEBUG_PORT_UART_0
		bool "UART 0"
	config DEBUG_PORT_UART_1
		bool "UART 1"
	config DEBUG_PORT_UART_2
		bool "UART 2"
	config DEBUG_PORT_UART_3
		bool "UART 3"
endchoice

if ASSERT

config ASSERT_LEVEL
	int "__ASSERT() level"
	default 2
	range 0 2
	help
      This option specifies the assertion level used by the __ASSERT()
	  macro. It can be set to one of three possible values:

	  Level 0: off
	  Level 1: on + warning in every file that includes __assert.h
	  Level 2: on + no warning
      	
endif # ASSERT

config FORCE_NO_ASSERT
	bool "Force-disable no assertions"
	help
	  This boolean option disables assertion testing even
	  in circumstances (twister) where it is enabled via
	  CFLAGS and not Kconfig.  Added solely to be able to work
	  around compiler bugs for specific tests.

config ASSERT_VERBOSE
	bool "Verbose assertions"
	default y
	help
	  This option enables printing an assert message with information about
	  the assertion that occurred. This includes printing the location,
	  the conditional expression and additional message specific to the
	  assert.

config ASSERT_NO_FILE_INFO
	bool "Disable file info for asserts"
	help
	  This option removes the name and the path of the source file
	  in which the assertion occurred. Enabling this will save
	  target code space, and thus may be necessary for tiny targets.

config ASSERT_NO_COND_INFO
	bool "Disable condition info for asserts"
	help
	  This option removes the assert condition from the printed assert
	  message. Enabling this will save target code space, and thus may be
	  necessary for tiny targets. It is recommended to disable condition
	  info before disabling file info since the condition can be found in
	  the source using file info.

config ASSERT_NO_MSG_INFO
	bool "Disable message for asserts"
	help
	  This option removes the additional message from the printed assert.
	  Enabling this will save target code space, and thus may be
	  necessary for tiny targets. It is recommended to disable message
	  before disabling file info since the message can be found in the
	  source using file info.



endif # DEBUG
```

## drivers/gpio/Kconfig
```kconfig
# Copyright (c) 2022 Nanjing Qinheng Microelectronics Co., Ltd.
# SPDX-License-Identifier: Apache-2.0

menuconfig GPIO
    bool "GPIO Drivers"
	default y
    help
      Enable GPIO drivers.

if GPIO

config GPIO_SUPPORT_INTERRUPT
	bool "GPIO interrupt"
	help
	  This is an option to be enabled by individual GPIO driver
	  to signal that the driver and hardware supports interrupts.

config GPIO_INIT_PRIORITY
	int "GPIO init priority"
	depends on GPIO_SUPPORT_INTERRUPT
	default 0
	help
	  GPIO driver device initialization priority.

endif
```

## drivers/pinctrl/Kconfig
```kconfig
# Copyright (c) 2022 Nanjing Qinheng Microelectronics Co., Ltd.
# SPDX-License-Identifier: Apache-2.0

menuconfig PINCTRL
	bool "Pin controller drivers"

if PINCTRL



endif
```

## drivers/uart/Kconfig
```kconfig
# Copyright (c) 2022 Nanjing Qinheng Microelectronics Co., Ltd.
# SPDX-License-Identifier: Apache-2.0

menuconfig UART
    bool "UART Drivers"
    help
      Enable options for uart drivers.

if UART

comment "Capabilities"

config UART_HAS_DRIVER
	bool
	help
	  This is an option to be enabled by individual uart driver
	  to signal that there is a uart driver. This is being used
	  by other drivers which are dependent on uart.

config UART_SUPPORT_ASYNC
	bool
	help
	  This is an option to be enabled by individual uart driver
	  to signal that the driver and hardware supports async operation.

config UART_SUPPORT_INTERRUPT
	bool
	help
	  This is an option to be enabled by individual uart driver
	  to signal that the driver and hardware supports interrupts.

config UART_INIT_PRIORITY
	int "Serial init priority"
	default 1
	help
	  Serial driver device initialization priority.

config UART_SUPPORT_WIDE_DATA
	bool
	help
	  This is an option to be enabled by individual uart driver
	  to signal that the driver and hardware support data longer
	  than 8-bit.

config UART_USE_RUNTIME_CONFIGURE
	bool "Runtime configuration for UART controllers"
	default y
	help
	  Enable runtime configuration of UART controllers.
	  This allows applications to call uart_configure() to
	  configure the UART controllers at runtime, and calling
	  uart_config_get() to retrieve configuration. If this is
	  disabled, UART controllers rely on UART driver's
	  initialization function to properly configure
	  the controller.

	  Say y if unsure. Disable this to reduce footprint for
	  applications that do not require runtime UART configuration.

config UART_ASYNC_API
	bool "Asynchronous UART API"
	depends on UART_SUPPORT_ASYNC
	help
	  This option enables asynchronous UART API.

config UART_INTERRUPT_DRIVEN
	bool "UART Interrupt support"
	depends on UART_SUPPORT_INTERRUPT
	help
	  This option enables interrupt support for UART allowing console
	  input and other UART based drivers.

config UART_LINE_CTRL
	bool "Serial Line Control API"
	help
	  This enables the API for apps to control the uart line,
	  such as baud rate, CTS and RTS.

	  Implementation is up to individual driver.

	  Says no if not sure.

config UART_DRV_CMD
	bool "Driver commands API"
	help
	  This enables the API to send extra commands to drivers.
	  This allows drivers to expose hardware specific functions.

	  Says no if not sure.

config UART_WIDE_DATA
	bool "API to support data longer than 8-bit"
	help
	  This enables the API to process data longer than 8-bit.
	  This is up to the driver to implement the necessary functions
	  to properly support this.

comment "Serial Drivers"

source "drivers/uart/Kconfig.ch57x"

source "drivers/uart/Kconfig.ch58x"

endif # UART
```

## drivers/uart/Kconfig.ch57x
```kconfig
# Copyright (c) 2022 Nanjing Qinheng Microelectronics Co., Ltd.
# SPDX-License-Identifier: Apache-2.0

config UART_CH57X
    bool "CH57x uart drivers"
    default y
    depends on SOC_SERIES_CH57X
    select UART_HAS_DRIVER
    select UART_SUPPORT_INTERRUPT
    help
      Enable the CH57x MCU driver.

if UART_CH57X

config UART_0_ENABLE
    bool "Uart 0"
    help
      Enable uart 0.

config UART_1_ENABLE
    bool "Uart 1"
    default y
    help
      Enable uart 1.

config UART_2_ENABLE
    bool "Uart 2"
    help
      Enable uart 2.

config UART_3_ENABLE
    bool "Uart 3"
    help
      Enable uart 3.

endif
```

## drivers/uart/Kconfig.ch58x
```kconfig
# Copyright (c) 2022 Nanjing Qinheng Microelectronics Co., Ltd.
# SPDX-License-Identifier: Apache-2.0

config UART_CH58X
    bool "CH58x uart drivers"
    default y
    depends on SOC_SERIES_CH58X
    select UART_HAS_DRIVER
    select UART_SUPPORT_INTERRUPT
    help
      Enable the CH57x MCU driver.

if UART_CH58X

config UART_0_ENABLE
    bool "Uart 0"
    help
      Enable uart 0.

config UART_1_ENABLE
    bool "Uart 1"
    default y
    help
      Enable uart 1.

config UART_2_ENABLE
    bool "Uart 2"
    help
      Enable uart 2.

config UART_3_ENABLE
    bool "Uart 3"
    help
      Enable uart 3.

endif
```
