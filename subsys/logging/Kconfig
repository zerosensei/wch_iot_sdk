## subsys/logging/Kconfig
```kconfig
# Copyright (c) 2022 Nanjing Qinheng Microelectronics Co., Ltd.
# SPDX-License-Identifier: Apache-2.0

menuconfig LOG
    bool "Logging"
    select PRINTK
    help
      Enable LOG function.

if LOG

config LOG_DEFAULT_LEVEL
    int "Default log level"
    default 3
    range  0 4
    help
      Sets log level. When set to 0 it means log will 
      not be activated. Levels are:

	  - 0 OFF, do not write by default
	  - 1 ERROR, default to only write LOG_LEVEL_ERR
	  - 2 WARNING, default to write LOG_LEVEL_WRN
	  - 3 INFO, default to write LOG_LEVEL_INFO
	  - 4 DEBUG, default to write LOG_LEVEL_DBG

endif
```

## subsys/pm/Kconfig
```kconfig
# Copyright (c) 2022 Nanjing Qinheng Microelectronics Co., Ltd.
# SPDX-License-Identifier: Apache-2.0

menuconfig PM
    bool "Power Management"
    help
      This option manages the power consumption of the chip in a unified manner 
      based on the kernel timer, and enables the chip to enter a low-power state 
      when the core is idle.

if PM

choice PM_POLICY
	prompt "Idle State Power Management Policy"
	default PM_POLICY_DEFAULT
	help
	  Select the idle state power management policy.

config PM_POLICY_DEFAULT
	bool "Default PM policy"
	help
	  This option selects the default PM policy. Default policy is based
	  on CPU residency times and other constraints imposed by the drivers or
	  application.

config PM_POLICY_CUSTOM
	bool "Custom PM Policy"
	help
	  This options allows applications to override the default policy with
	  a custom implementation.

endchoice

config PM_RESIDENCY_TIME_MAX
	int "Maximum time in low power mode (in s)"
	default 85484
	depends on SOC_SERIES_CH58X
	help
	  Maximum time to stay in low power mode.
	  
config PM_ACTIVE_USEC
	int "Minimum time to enter idle (in us)"
	default 100
	help
	  The minimum number of microseconds to enter idle, 
	  when less than its value do not enter idle.

config PM_IDLE_USEC
	int "Minimum time to enter sleep (in us)"
	default 1400
	help
	  The maximum number of microseconds to enter idle, 
	  when greater than its value, enter sleep if sleep is enabled.

endif
```
